## drivers/staging/mhi/Kconfig
```kconfig
comment "Qualcomm MHI module Samsung Version"

config QCOM_SEC_MHI

	tristate "Qualcomm MHI module Samsung Version"
	default n
	help
	Add support for the Qualcomm MHI module Samsung Version
```
